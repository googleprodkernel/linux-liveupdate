## drivers/misc/liveupdate/Kconfig
```kconfig
# SPDX-License-Identifier: GPL-2.0-only
#
# Copyright (c) 2025, Google LLC.
# Pasha Tatashin <pasha.tatashin@soleen.com>
#
# Live Update Orchestrator
#

config LIVEUPDATE
	bool "Live Update Orchestrator"
	depends on KEXEC_HANDOVER
	help
	  Enable the Live Update Orchestrator. Live Update is a mechanism,
	  typically based on kexec, that allows the kernel to be updated
	  while keeping selected devices operational across the transition.
	  These devices are intended to be reclaimed by the new kernel and
	  re-attached to their original workload without requiring a device
	  reset.

	  This functionality depends on specific support within device drivers
	  and related kernel subsystems.

	  This feature is primarily used in cloud environments to quickly
	  update the kernel hypervisor with minimal disruption to the
	  running virtual machines.

	  If unsure, say N.

config LIVEUPDATE_SYSFS_API
	bool "Live Update sysfs monitoring interface"
	depends on SYSFS
	depends on LIVEUPDATE
	help
	  Enable a sysfs interface for the Live Update Orchestrator
	  at /sys/kernel/liveupdate/.

	  This allows monitoring the LUO state ('normal', 'prepared',
	  'frozen', 'updated') via the read-only 'state' file.

	  This interface complements the primary /dev/liveupdate ioctl
	  interface, which handles the full update process.
	  This sysfs API may be useful for scripting, or userspace monitoring
	  needed to coordinate application restarts and minimize downtime.

	  If unsure, say N.

config LIVEUPDATE_SELFTESTS
	bool "Live Update Orchestrator - self tests"
	depends on LIVEUPDATE
	help
	  Say Y here to build self-tests for the LUO framework. When enabled,
	  these tests can be initiated via the ioctl interface to help verify
	  the core live update functionality.

	  This option is primarily intended for developers working on the
	  live update feature or for validation purposes during system
	  integration.

	  If you are unsure or are building a production kernel where size
	  or attack surface is a concern, say N.
```

## kernel/Kconfig.liveupdate
```kconfig
# SPDX-License-Identifier: GPL-2.0-only
#
# Live update configs
#

config ARCH_SUPPORTS_LIVEUPDATE
	bool

config LIVEUPDATE
	bool "Enable kernel live update"
	depends on ARCH_SUPPORTS_LIVEUPDATE
	depends on KEXEC_HANDOVER
	help
	  Enables support for Live Update, a feature that allows to
	  keep devices alive across the transition from the old kernel
	  to the new kernel. Live Update designed to minimize downtime
	  during kernel updates

	  If unsure, say N.
```

## kernel/liveupdate/Kconfig
```kconfig
# SPDX-License-Identifier: GPL-2.0-only

menu "Live Update and Kexec HandOver"

config KEXEC_HANDOVER
	bool "kexec handover"
	depends on ARCH_SUPPORTS_KEXEC_HANDOVER && ARCH_SUPPORTS_KEXEC_FILE
	select MEMBLOCK_KHO_SCRATCH
	select KEXEC_FILE
	select LIBFDT
	select CMA
	help
	  Allow kexec to hand over state across kernels by generating and
	  passing additional metadata to the target kernel. This is useful
	  to keep data or state alive across the kexec. For this to work,
	  both source and target kernels need to have this option enabled.

config KEXEC_HANDOVER_DEBUG
	bool "Enable Kexec Handover debug checks"
	depends on KEXEC_HANDOVER
	help
	  This option enables extra sanity checks for the Kexec Handover
	  subsystem. Since, KHO performance is crucial in live update
	  scenarios and the extra code might be adding overhead it is
	  only optionally enabled.

config KEXEC_HANDOVER_DEBUGFS
	bool "kexec handover debugfs interface"
	default KEXEC_HANDOVER
	depends on KEXEC_HANDOVER
	select DEBUG_FS
	help
	  Allow to control kexec handover device tree via debugfs
	  interface, i.e. finalize the state or aborting the finalization.
	  Also, enables inspecting the KHO fdt trees with the debugfs binary
	  blobs.

config KEXEC_HANDOVER_ENABLE_DEFAULT
	bool "Enable kexec handover by default"
	depends on KEXEC_HANDOVER
	help
	  Enable Kexec Handover by default. This avoids the need to
	  explicitly pass 'kho=on' on the kernel command line.

	  This is useful for systems where KHO is a prerequisite for other
	  features, such as Live Update, ensuring the mechanism is always
	  active.

	  The default behavior can still be overridden at boot time by
	  passing 'kho=off'.

config KEXEC_HANDOVER_READONLY
	bool "Read-only kexec handover"
	depends on ARCH_SUPPORTS_KEXEC_HANDOVER
	select LIBFDT
	help
	  Enable read-only Kexec Handover ('kho_ro=<pa>'). This allows a
	  kernel to traverse preserved KHO subtrees, radix trees, and
	  metadata by mapping them in place without taking ownership of
	  or modifying the preserved KHO state.

config LIVEUPDATE
	bool "Live Update Orchestrator"
	depends on KEXEC_HANDOVER || KEXEC_HANDOVER_READONLY
	help
	  Enable the Live Update Orchestrator. Live Update is a mechanism,
	  typically based on kexec, that allows the kernel to be updated
	  while keeping selected devices operational across the transition.
	  These devices are intended to be reclaimed by the new kernel and
	  re-attached to their original workload without requiring a device
	  reset.

	  Ability to handover a device from current to the next kernel depends
	  on specific support within device drivers and related kernel
	  subsystems.

	  This feature primarily targets virtual machine hosts to quickly update
	  the kernel hypervisor with minimal disruption to the running virtual
	  machines.

	  If unsure, say N.

config LIVEUPDATE_SHMEM
	bool "Live update support for memfd and tmpfs files"
	depends on LIVEUPDATE
	depends on MEMFD_CREATE
	depends on SHMEM
	default LIVEUPDATE
	help
	  Enable live update support for memfds and tmpfs files. This allows
	  preserving their contents across kernel live updates.

	  This can be used to back VM memory with memfds, allowing the guest
	  memory to persist, or for other user workloads needing to preserve
	  pages.

	  If unsure, say N.

config LIVEUPDATE_GUEST_MEMFD
	bool "Live update support for guest_memfd"
	depends on LIVEUPDATE
	depends on KVM_GUEST_MEMFD
	default LIVEUPDATE
	help
	  Enable live update support for KVM guest_memfd files. This allows
	  preserving VM Memory backed by guest_memfd file across kernel live
	  updates.

	  This can only be used for the guest_memfd that are fully-shared
	  and pre-faulted.

	  If unsure, say N.

config ARCH_SUPPORTS_LIVEUPDATE_CPU
	bool

config LIVEUPDATE_CPU
	bool "Live update support for preserved CPUs"
	depends on LIVEUPDATE
	depends on ARCH_SUPPORTS_LIVEUPDATE_CPU
	depends on HOTPLUG_CPU
	depends on HOTPLUG_CORE_SYNC_DEAD
	help
	  Enable live update support for physical CPU preservation.

	  This feature allows physical CPU cores to keep running across
	  kexec-based live updates, without a hardware reset.

	  When a core is preserved, it is taken down through CPU hotplug
	  and parked in a small runtime in preserved memory. Its stack and
	  page tables are handed over across kexec using KHO. The incoming
	  kernel finds preserved cores during early boot and does not
	  bring them up; they are returned to Linux when userspace retrieves
	  and finishes the LUO session.

	  Preservation lifecycle is managed from userspace via LUO sessions
	  associated with /sys/devices/system/cpu/cpu<N>/preserve file
	  descriptors, and monitored via sysfs.

	  Orphaned jobs can be submitted to run on the preserved CPUs.

	  If unsure, say N.

endmenu
```
